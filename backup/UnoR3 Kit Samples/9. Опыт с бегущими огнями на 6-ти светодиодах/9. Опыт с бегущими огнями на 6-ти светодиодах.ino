int Led1 = 1;
int Led2 = 2;
int Led3 = 3;
int Led4 = 4;
int Led5 = 5;
int Led6 = 6; 

void lamp(void) 
{ 
 unsigned char j; 
 for(j=1; j<=6; j++) //через цикл проходимся по всем 6 светодиодам
	              { 
	              digitalWrite(j,HIGH); //каждому светодиоду присваиваем "HIGH", тем самым он загорается.
	              delay(200); //делаем задержку в 200 Мс, что потухание было плавное
        } 
        for(j=6; j>=1; j--) //снова делаем цикл, чтоб пройтись по светодиодам и их выключить
        { 
                digitalWrite(j,LOW); //каждому светодидоу в обратном порядке присваиваем "LOW", тем самым его выключая
                delay(200); //снова делаем задержку в 200 Мс, что потухание было плавное
        }
} 
void setup() 
{ 
	unsigned char i;	
  for(i=1;i<=6;i++)// пины 1-6 работают как выходные 
		pinMode(i, OUTPUT);// i-й пин работает как выходной 
}
void loop() 
{ 
	lamp(); 
} 